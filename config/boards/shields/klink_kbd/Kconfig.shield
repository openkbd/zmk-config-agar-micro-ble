## config/boards/shields/klink_kbd/Kconfig.shield
```kconfig
# Copyright (c) 2020 The ZMK Contributors
# SPDX-License-Identifier: MIT

config SHIELD_AGAR_MICRO_BLE
    def_bool $(shields_list_contains,agar_micro_ble)
```
